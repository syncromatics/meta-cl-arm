## conf/layer.conf
```bitbake
# We have a conf and classes directory, add to BBPATH
BBPATH .= ":${LAYERDIR}"

# We have recipes-* directories, add to BBFILES
BBFILES += "${LAYERDIR}/recipes-*/*/*.bb \
	${LAYERDIR}/recipes-*/*/*.bbappend"

BBFILE_COLLECTIONS += "imx7d-sbc-iot-imx7-bsp"
BBFILE_PATTERN_imx7d-sbc-iot-imx7-bsp = "^${LAYERDIR}/"
BBFILE_PRIORITY_imx7d-sbc-iot-imx7-bsp = "6"

LAYERDEPENDS_imx7d-sbc-iot-imx7-bsp = "fsl-arm"
LAYERVERSION_imx7d-sbc-iot-imx7-bsp = "1"
```

## conf/machine/imx7d-sbc-iot-imx7.conf
```bitbake
#@TYPE: Machine
#@NAME: CompuLab IMX7 IOT Gateway
#@SOC: i.MX7D
#@DESCRIPTION: Machine configuration for CompuLab IMX7 IOT Gateway
#@MAINTAINER: Gergely Imreh <gergelyimreh@via.com.tw>

require conf/machine/include/imx7d-sbc-iot.inc

SOC_FAMILY = "mx7:mx7d:imx7d-sbc-iot-imx7"

KERNEL_DEVICETREE ?= "imx7d-sbc-iot-imx7.dtb"

#UBOOT_MACHINE ?= "mx6qvab820"

MACHINE_FEATURES += ""
```

## conf/machine/include/imx7d-sbc-iot.inc
```bitbake
# Common settings for IMX7D Iot Gate boards

include conf/machine/include/imx-base.inc
include conf/machine/include/tune-cortexa9.inc

PREFERRED_PROVIDER_u-boot ?= "u-boot-imx7d-iot-gate"
PREFERRED_PROVIDER_virtual/kernel ?= "linux-imx7d-iot-gate"
PREFERRED_VERSION_linux-imx7d-iot-gate ?= "4.1.15"

SERIAL_CONSOLE = "115200 ttymxc1"

MACHINE_FEATURES += " pci rtc"

KERNEL_IMAGETYPE = "uImage"

IMX_TEST_SUPPORT = "y"
```
